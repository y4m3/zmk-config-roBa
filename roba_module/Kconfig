## roba_module/Kconfig
```kconfig
config ROBA_PROFILE_SETTINGS
    bool "roBa per-profile layout and connection settings"
    default y
    select SETTINGS
    help
      Store the Apple/Windows layout and connection policy for each Bluetooth
      profile and restore them when the active profile changes.
```

## roba_module/dts/bindings/zmk,behavior-profile-settings.yaml
```yaml
description: roBa per-Bluetooth-profile layout and connection settings behavior

compatible: "zmk,behavior-profile-settings"

include: one_param.yaml

properties:
  apple-layer:
    type: int
    required: true
    description: Layer activated for the Apple layout.

  base-layer:
    type: int
    required: true
    description: Layer activated for the Windows/Linux layout.
```
